## config/boards/shields/lyra34/Kconfig.defconfig
```kconfig
# Copyright (c) 2020 The ZMK Contributors
# SPDX-License-Identifier: MIT

if SHIELD_LYRA34

config ZMK_KEYBOARD_NAME
    default "Lyra34"

endif
```

## config/west.yml
```yaml
manifest:
  remotes:
    - name: jibingeo
      url-base: https://github.com/jibingeo
    - name: zmkfirmware
      url-base: https://github.com/zmkfirmware
    - name: urob
      url-base: https://github.com/urob
  projects:
    - name: zmk
      remote: urob
      revision: main
      import: app/west.yml
    - name: iqs5xx-input-module
      remote: jibingeo
      revision: main
      path: modules/lib/iqs5xx-input
  self:
    path: config
```
